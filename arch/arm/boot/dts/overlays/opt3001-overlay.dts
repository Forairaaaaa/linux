// Definitions for TI OPT3001 ambient light sensor
/dts-v1/;
/plugin/;

#include <dt-bindings/gpio/gpio.h>
#include <dt-bindings/interrupt-controller/irq.h>

/ {
	compatible = "brcm,bcm2835";

	fragment@0 {
		target = <&i2c1>;

		__overlay__ {
			status = "okay";

			#address-cells = <1>;
			#size-cells = <0>;

            opt3001: opt3001@44 {
                compatible = "ti,opt3001";
                reg = <0x44>;
				status = "okay";

                // interrupt-parent = <&rp1_gpio>;
                // interrupts = <26 IRQ_TYPE_EDGE_FALLING>;
            };
		};
	};

	__overrides__ {
		addr = <&opt3001>,"reg:0";
		int_pin = <&opt3001>,"interrupts:0",
			  <&opt3001>,"interrupt-parent:0";
	};
}; 	