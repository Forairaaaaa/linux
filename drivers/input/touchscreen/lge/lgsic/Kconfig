## drivers/input/touchscreen/lge/lgsic/Kconfig
```kconfig
#
# LGE touch core configuration
#
if INPUT_TOUCHSCREEN

menuconfig LGE_TOUCH_LGSIC_SW42000
        bool "LGE Touch Core ODM Device Driver - SW42000"
        depends on LGE_TOUCH_CORE_BASE
        help
          If your device is sw42000, say Y

# To Do : LGSIC Chipseet
endif
```
